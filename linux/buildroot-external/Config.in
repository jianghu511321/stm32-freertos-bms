## linux/buildroot-external/Config.in
```kconfig
menu "BMS demo packages"
source "$BR2_EXTERNAL_BMS_PATH/package/bms-gateway/Config.in"
source "$BR2_EXTERNAL_BMS_PATH/package/bms-can-monitor/Config.in"
endmenu
```

## linux/buildroot-external/configs/bms_qemu_aarch64_defconfig
```kconfig
BR2_aarch64=y
BR2_cortex_a53=y
BR2_TOOLCHAIN_BUILDROOT_MUSL=y
BR2_TARGET_GENERIC_HOSTNAME="bms-qemu"
BR2_TARGET_GENERIC_ISSUE="STM32 FreeRTOS BMS SocketCAN gateway"
BR2_TARGET_GENERIC_GETTY_PORT="ttyAMA0"
BR2_ROOTFS_OVERLAY="$(BR2_EXTERNAL_BMS_PATH)/board/qemu-aarch64/rootfs-overlay"
BR2_LINUX_KERNEL=y
BR2_LINUX_KERNEL_CUSTOM_VERSION=y
BR2_LINUX_KERNEL_CUSTOM_VERSION_VALUE="6.6.52"
BR2_KERNEL_HEADERS_AS_KERNEL=y
BR2_PACKAGE_HOST_LINUX_HEADERS_CUSTOM_6_6=y
BR2_LINUX_KERNEL_USE_ARCH_DEFAULT_CONFIG=y
BR2_LINUX_KERNEL_CONFIG_FRAGMENT_FILES="$(BR2_EXTERNAL_BMS_PATH)/board/qemu-aarch64/linux.fragment"
BR2_PACKAGE_IPROUTE2=y
BR2_PACKAGE_CAN_UTILS=y
BR2_PACKAGE_BMS_GATEWAY=y
BR2_PACKAGE_BMS_CAN_MONITOR=y
BR2_TARGET_ROOTFS_EXT2=y
BR2_TARGET_ROOTFS_EXT2_4=y
BR2_TARGET_ROOTFS_EXT2_SIZE="120M"
```

## linux/buildroot-external/package/bms-can-monitor/Config.in
```kconfig
config BR2_PACKAGE_BMS_CAN_MONITOR
	bool "bms-can-monitor"
	depends on BR2_LINUX_KERNEL
	help
	  Kernel module that buffers BMS CAN telemetry and exposes it in debugfs.
```

## linux/buildroot-external/package/bms-gateway/Config.in
```kconfig
config BR2_PACKAGE_BMS_GATEWAY
	bool "bms-gateway"
	depends on BR2_TOOLCHAIN_HAS_THREADS
	help
	  SocketCAN telemetry collector for the STM32 FreeRTOS BMS demo.
```
